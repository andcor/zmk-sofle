## config/west.yml
```yaml
manifest:
  remotes:
    - name: zmkfirmware
      url-base: https://github.com/zmkfirmware
      # Additional modules containing boards/shields/custom code can be listed here as well.
      # See:
      # - https://zmk.dev/docs/features/modules
      # - https://docs.zephyrproject.org/3.5.0/develop/west/manifest.html#projects
    - name: urob
      url-base: https://github.com/urob
    #- name: gpeye
    #  url-base: https://github.com/GPeye
  projects:
   # - name: mario-peripheral-animation
   #   remote: gpeye
   #    revision: main 
    - name: eyelash_sofle
      url: https://github.com/a741725193/zmk-sofle
      revision: main
    - name: zmk
      remote: zmkfirmware
      revision: v0.3.0
      import: app/west.yml
    - name: zmk-helpers
      remote: urob
      revision: main
    - name: zmk-central-states-relay
      url: https://github.com/ArtemYurov/zmk-central-states-relay
      revision: 39e3d8ab15fded008c543618acce7a1724ca0459
  self:
    path: boards
```

## central-states-relay/Kconfig
```kconfig
# Copyright (c) 2026 Artem Yurov
# SPDX-License-Identifier: MIT

DT_COMPAT_ZMK_CENTRAL_STATES_RELAY := zmk,central-states-relay
config ZMK_CENTRAL_STATES_RELAY
	bool
	default $(dt_compat_enabled,$(DT_COMPAT_ZMK_CENTRAL_STATES_RELAY))
	select ZMK_HID_INDICATORS if ZMK_SPLIT_ROLE_CENTRAL

config CSR_RELAY_WPM
	bool "Relay WPM data to peripheral"
	default n
	depends on ZMK_CENTRAL_STATES_RELAY && ZMK_SPLIT_ROLE_CENTRAL
	select ZMK_WPM
	help
	  Enable WPM (words per minute) relay to peripheral.
	  Generates frequent BLE traffic during active typing.
	  Disable to save power if WPM display is not needed.
```

## central-states-relay/dts/bindings/zmk,central-states-relay.yaml
```yaml
# Copyright (c) 2026 Artem Yurov
# SPDX-License-Identifier: MIT

description: |
  Enables central-to-peripheral states relay over BLE split link.
  Transmits device state, HID indicators, battery level, layer info,
  and modifier state to peripheral halves for display widget consumption.

compatible: "zmk,central-states-relay"

properties: {}
```
